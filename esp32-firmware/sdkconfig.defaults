## esp32-firmware/sdkconfig.defaults
```kconfig
# ============================================================================
# sdkconfig.defaults  —  ESP-IDF v5.x 默认配置
# 目标：ESP32（经典），Flash 4MB DIO 40MHz，NimBLE 中心角色，mbedTLS。
# 说明：本文件在首次 `idf.py set-target esp32` / `idf.py build` 时被读取，
#       生成 sdkconfig。修改后需 `idf.py reconfigure` 或删除 sdkconfig 重建。
# ============================================================================

# ---------- 目标芯片 / Flash ----------
CONFIG_IDF_TARGET="esp32"
CONFIG_ESPTOOLPY_FLASHSIZE_4MB=y
CONFIG_ESPTOOLPY_FLASHSIZE="4MB"
CONFIG_ESPTOOLPY_FLASHMODE_DIO=y
CONFIG_ESPTOOLPY_FLASHFREQ_40M=y
CONFIG_ESPTOOLPY_FLASHFREQ="40MHz"
CONFIG_ESP_MAIN_TASK_STACK_SIZE=8192

# ---------- FreeRTOS / 内存 ----------
CONFIG_ESP_MAIN_TASK_STACK_SIZE=8192
CONFIG_FREERTOS_HZ=100
# BT 需要较多内部 RAM，打开 IRAM 优化时谨慎；这里保持默认即可。

# ---------- WiFi ----------
CONFIG_ESP_WIFI_ENABLED=y
CONFIG_ESP_WIFI_STATIC_RX_BUFFER_NUM=16
CONFIG_ESP_WIFI_DYNAMIC_RX_BUFFER_NUM=32
CONFIG_ESP_WIFI_DYNAMIC_TX_BUFFER_NUM=32
CONFIG_ESP_WIFI_TX_BA_WIN=6
CONFIG_ESP_WIFI_RX_BA_WIN=6
CONFIG_ESP_WIFI_NVS_ENABLED=y

# ---------- Bluedroid 关闭，改用 NimBLE ----------
CONFIG_BT_ENABLED=y
CONFIG_BTDM_CTRL_MODE_BLE_ONLY=y
CONFIG_BTDM_CTRL_MODE_BR_EDR_ONLY=n
CONFIG_BTDM_CTRL_MODE_BTDM=n
CONFIG_BT_NIMBLE_ENABLED=y
CONFIG_BT_NIMBLE_ROLE_CENTRAL=y
CONFIG_BT_NIMBLE_ROLE_OBSERVER=y
CONFIG_BT_NIMBLE_ROLE_PERIPHERAL=n
CONFIG_BT_NIMBLE_ROLE_BROADCASTER=n
# 中心角色需要 GATT client
CONFIG_BT_NIMBLE_GATT_CLIENT_ENABLE=y
CONFIG_BT_NIMBLE_SM_LEGACY=y
# SM_SC 必须开启：ble_sm_alg_aes_cmac 仅在 SC 下编译，
# 而 ble_att_svr 无条件引用它（否则链接报 undefined reference）。
CONFIG_BT_NIMBLE_SM_SC=y
# 我们自己实现配对密钥（authkey），不依赖 NimBLE 的 bonding 持久化；
# 但仍允许 SM 以完成底层加密协商（若手环要求）。
CONFIG_BT_NIMBLE_NVS_PERSIST=y
CONFIG_BT_NIMBLE_MAX_CONNECTIONS=1
CONFIG_BT_NIMBLE_MAX_BONDS=1
CONFIG_BT_NIMBLE_NVS_BOND_SECURITY=y
# MTU：允许运行时协商到较大值（有效负载 = MTU-3）
CONFIG_BT_NIMBLE_ATT_PREFERRED_MTU=247
CONFIG_BT_NIMBLE_CHACHA_VS_AES=y

# ---------- mbedTLS（自实现 AES-128-CCM / CTR / HKDF / HMAC-SHA256）----------
CONFIG_MBEDTLS_HARDWARE_AES=y
CONFIG_MBEDTLS_HARDWARE_SHA=y
CONFIG_MBEDTLS_HARDWARE_MPI=y
CONFIG_MBEDTLS_CCM_C=y
CONFIG_MBEDTLS_AES_C=y
CONFIG_MBEDTLS_CIPHER_MODE_CTR=y
CONFIG_MBEDTLS_CIPHER_MODE_CBC=n
CONFIG_MBEDTLS_SHA256_C=y
CONFIG_MBEDTLS_SHA256_HW_ACCEL=y
CONFIG_MBEDTLS_HKDF_C=y
CONFIG_MBEDTLS_MD_C=y
CONFIG_MBEDTLS_GCM_C=n
# HTTPS 客户端需要
CONFIG_MBEDTLS_TLS_ENABLED=y
CONFIG_MBEDTLS_SERVER_NAME_INDICATION=y
CONFIG_MBEDTLS_SSL_PROTO_TLS1_2=y
CONFIG_MBEDTLS_SSL_KEEP_PEER_CERTIFICATE=n
# 减小 HTTPS 内存占用
CONFIG_MBEDTLS_DYNAMIC_BUFFER=y
CONFIG_MBEDTLS_DYNAMIC_FREE_CONFIG_DATA=y

# ---------- HTTP client ----------
CONFIG_ESP_HTTP_CLIENT_ENABLE_HTTPS=y

# ---------- 日志 ----------
CONFIG_LOG_DEFAULT_LEVEL_INFO=y
CONFIG_LOG_MAXIMUM_EQUALS_DEFAULT=y
CONFIG_BOOTLOADER_LOG_LEVEL_INFO=y

# ---------- 分区表 ----------
CONFIG_PARTITION_TABLE_CUSTOM=y
CONFIG_PARTITION_TABLE_CUSTOM_FILENAME="partitions.csv"
```
